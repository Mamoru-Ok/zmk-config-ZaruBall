## boards/shields/zaru_ball_left/Kconfig.shield
```kconfig
#No whitespace after the comma or in your part name!
config SHIELD_ZARUBALL_LEFT
	def_bool $(shields_list_contains, zaru_ball_left)

config SHIELD_ZARUBALL_RIGHT
	def_bool $(shields_list_contains, zaru_ball_right)
```
